## mydazy-p30-4g/main/Kconfig.projbuild
```kconfig
menu "Claude Buddy"

config CLAUDE_BUDDY_BRAND_NAME
    string "Advertised name prefix"
    default "Claude"
    help
        Must start with "Claude" so the desktop's device picker can
        filter to it. The firmware appends the last two BT MAC bytes
        as suffix (e.g. "Claude-A1B2").

config CLAUDE_BUDDY_DEFAULT_BRIGHTNESS
    int "Default LCD backlight duty (0..100)"
    range 5 100
    default 35

endmenu
```

## mydazy-p30-4g/sdkconfig.defaults
```kconfig
# Target & PSRAM (mydazy-p30-4g uses ESP32-S3R8 with Octal PSRAM)
CONFIG_IDF_TARGET="esp32s3"
CONFIG_IDF_TARGET_ESP32S3=y
CONFIG_ESPTOOLPY_FLASHSIZE_16MB=y
CONFIG_ESPTOOLPY_FLASHSIZE="16MB"
CONFIG_ESPTOOLPY_FLASHFREQ_80M=y
CONFIG_ESPTOOLPY_FLASHMODE_QIO=y

CONFIG_SPIRAM=y
CONFIG_SPIRAM_MODE_OCT=y
CONFIG_SPIRAM_SPEED_80M=y
CONFIG_SPIRAM_USE_MALLOC=y
CONFIG_SPIRAM_TRY_ALLOCATE_WIFI_LWIP=y
CONFIG_SPIRAM_MALLOC_RESERVE_INTERNAL=65536

# Partition table
CONFIG_PARTITION_TABLE_CUSTOM=y
CONFIG_PARTITION_TABLE_CUSTOM_FILENAME="partitions.csv"
CONFIG_PARTITION_TABLE_FILENAME="partitions.csv"

# Bluetooth (NimBLE host, peripheral role, no BR/EDR)
CONFIG_BT_ENABLED=y
CONFIG_BT_NIMBLE_ENABLED=y
CONFIG_BT_NIMBLE_ROLE_PERIPHERAL=y
CONFIG_BT_NIMBLE_ROLE_BROADCASTER=y
CONFIG_BT_NIMBLE_ROLE_OBSERVER=n
CONFIG_BT_NIMBLE_ROLE_CENTRAL=n
CONFIG_BT_NIMBLE_HOST_TASK_STACK_SIZE=5120
CONFIG_BT_NIMBLE_MAX_CONNECTIONS=1
CONFIG_BT_NIMBLE_MAX_BONDS=4
CONFIG_BT_NIMBLE_MAX_CCCDS=8
CONFIG_BT_NIMBLE_NVS_PERSIST=y
CONFIG_BT_NIMBLE_SM_LEGACY=n
CONFIG_BT_NIMBLE_SM_SC=y
CONFIG_BT_NIMBLE_DEBUG=n
CONFIG_BT_NIMBLE_LOG_LEVEL_INFO=y

# LWIP — disabled, we don't use the network stack
CONFIG_LWIP_TCPIP_TASK_STACK_SIZE=4096

# FreeRTOS
CONFIG_FREERTOS_HZ=1000
CONFIG_FREERTOS_USE_TICKLESS_IDLE=n
CONFIG_FREERTOS_GENERATE_RUN_TIME_STATS=n

# Logging
CONFIG_LOG_DEFAULT_LEVEL_INFO=y
CONFIG_BOOTLOADER_LOG_LEVEL_WARN=y

# Console
CONFIG_ESP_CONSOLE_UART_DEFAULT=y
CONFIG_ESP_CONSOLE_UART_BAUDRATE=115200

# LVGL knobs (the rest come from esp_lvgl_port defaults)
# LV_COLOR_16_SWAP intentionally OFF — esp_lvgl_port's swap_bytes=true
# does the BE conversion before DMA. Two swaps would cancel out and give
# the JD9853 a little-endian frame, which it renders as random color noise.
CONFIG_LV_COLOR_DEPTH_16=y
CONFIG_LV_USE_PERF_MONITOR=n
CONFIG_LV_DEF_REFR_PERIOD=33
CONFIG_LV_FONT_MONTSERRAT_14=y
CONFIG_LV_FONT_MONTSERRAT_16=y
CONFIG_LV_FONT_MONTSERRAT_24=y
CONFIG_LV_FONT_DEFAULT_MONTSERRAT_16=y

# Panic behavior matches mydazy-p30-4g (silent halt rather than reboot loop)
CONFIG_ESP_SYSTEM_PANIC_PRINT_HALT=y

# RTC GPIO hold across deep sleep + soft restart (needed by ShutdownHandler)
CONFIG_PM_ENABLE=n
CONFIG_RTC_CLK_SRC_INT_RC=y

# espressif/button
CONFIG_BUTTON_PERIOD_TIME_MS=20
```
